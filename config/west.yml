## config/west.yml
```yaml
manifest:
  remotes:
    - name: zmkfirmware
      url-base: https://github.com/vrinek
  projects:
    - name: zmk
      remote: zmkfirmware
      revision: masked-mod-morphs-corne-ish-zen
      import: app/west.yml
  self:
    path: config
```
